## Kconfig
```kconfig
config ZMK_INPUT_PROCESSOR_INERTIAL_SCROLL
    bool "Enable inertial scroll input processor"
    default y
    help
      Enable the inertial scroll input processor that adds momentum-based
      scrolling similar to touchpad or smartphone scrolling.

config ZMK_INERTIAL_SCROLL_TICK_MS
    int "Inertial scroll tick interval in milliseconds"
    default 16
    help
      The interval between inertial scroll updates. Lower values give
      smoother scrolling but use more CPU.
```

## dts/bindings/input-processors/zmk,input-processor-inertial-scroll.yaml
```yaml
# Copyright (c) 2024 The ZMK Contributors
# SPDX-License-Identifier: MIT

description: Inertial Scroll Input Processor - Adds momentum-based scrolling

compatible: "zmk,input-processor-inertial-scroll"

include: ip_zero_param.yaml

properties:
  friction:
    type: int
    default: 15
    description: Base friction coefficient (1-100)

  min-velocity:
    type: int
    default: 50
    description: Minimum velocity to trigger inertia

  max-velocity:
    type: int
    default: 2000
    description: Maximum velocity cap

  max-duration-ms:
    type: int
    default: 1500
    description: Maximum inertia duration in ms

  velocity-scale:
    type: int
    default: 100
    description: Velocity scale factor (percentage)
```
